## agent-esp32/components/synap_agent/Kconfig
```kconfig
menu "Synap ESP32 Agent"

config SYNAP_PROVISION_PARTITION
    string "Provisioning NVS partition"
    default "provision"

config SYNAP_RUNTIME_PARTITION
    string "Runtime identity NVS partition"
    default "runtime"

config SYNAP_SPOOL_PARTITION
    string "Durable spool NVS partition"
    default "spool"

config SYNAP_DEAD_LETTER_PARTITION
    string "Dead-letter NVS partition"
    default "dead_letter"

config SYNAP_QUEUE_MAX_RECORDS
    int "Maximum queued records"
    range 8 512
    default 128

config SYNAP_QUEUE_MAX_RECORD_BYTES
    int "Maximum encoded record bytes"
    range 1024 32768
    default 32768

config SYNAP_DEAD_LETTER_MAX_RECORDS
    int "Maximum dead-letter records"
    range 1 64
    default 16

config SYNAP_WORKER_STACK_SIZE
    int "Worker task stack size"
    range 8192 24576
    default 12288

config SYNAP_ALLOW_INSECURE_HTTP
    bool "Allow cleartext HTTP for local development"
    default n
    help
        This removes TLS only. Protocol-v1 application encryption remains
        mandatory. Never enable this option in a production image.

endmenu
```

## synap-agent/agent-esp32/sdkconfig.defaults
```kconfig
CONFIG_PARTITION_TABLE_CUSTOM=y
CONFIG_PARTITION_TABLE_CUSTOM_FILENAME="partitions.csv"
CONFIG_ESP_MAIN_TASK_STACK_SIZE=6144
CONFIG_ESP_EVENT_TASK_STACK_SIZE=3072
CONFIG_MBEDTLS_HKDF_C=y
CONFIG_MBEDTLS_GCM_C=y
CONFIG_MBEDTLS_ECP_C=y
CONFIG_MBEDTLS_ECDH_C=y
CONFIG_MBEDTLS_ECDSA_C=y
CONFIG_MBEDTLS_ECP_DP_SECP256R1_ENABLED=y
CONFIG_MBEDTLS_PEM_PARSE_C=y
CONFIG_MBEDTLS_CERTIFICATE_BUNDLE=y
CONFIG_ESP_TLS_USE_SECURE_ELEMENT=n
CONFIG_LOG_DEFAULT_LEVEL_INFO=y
CONFIG_COMPILER_OPTIMIZATION_SIZE=y
CONFIG_SYNAP_PROVISION_PARTITION="provision"
CONFIG_SYNAP_RUNTIME_PARTITION="runtime"
CONFIG_SYNAP_SPOOL_PARTITION="spool"
CONFIG_SYNAP_DEAD_LETTER_PARTITION="dead_letter"
CONFIG_SYNAP_QUEUE_MAX_RECORDS=128
CONFIG_SYNAP_QUEUE_MAX_RECORD_BYTES=32768
CONFIG_SYNAP_DEAD_LETTER_MAX_RECORDS=16
CONFIG_SYNAP_WORKER_STACK_SIZE=12288
CONFIG_SYNAP_ALLOW_INSECURE_HTTP=n
```

## synap-agent/agent-esp32/test/firmware/sdkconfig.defaults
```kconfig
CONFIG_PARTITION_TABLE_CUSTOM=y
CONFIG_PARTITION_TABLE_CUSTOM_FILENAME="partitions.csv"
CONFIG_MBEDTLS_HKDF_C=y
CONFIG_MBEDTLS_GCM_C=y
CONFIG_MBEDTLS_ECP_C=y
CONFIG_MBEDTLS_ECDH_C=y
CONFIG_MBEDTLS_ECDSA_C=y
CONFIG_MBEDTLS_ECP_DP_SECP256R1_ENABLED=y
CONFIG_MBEDTLS_CERTIFICATE_BUNDLE=y
CONFIG_ESP_MAIN_TASK_STACK_SIZE=8192
CONFIG_UNITY_ENABLE_FLOAT=y
CONFIG_UNITY_ENABLE_DOUBLE=y
CONFIG_UNITY_ENABLE_IDF_TEST_RUNNER=y
CONFIG_SYNAP_PROVISION_PARTITION="test_provision"
CONFIG_SYNAP_RUNTIME_PARTITION="test_runtime"
CONFIG_SYNAP_SPOOL_PARTITION="test_spool"
CONFIG_SYNAP_DEAD_LETTER_PARTITION="test_dead"
CONFIG_SYNAP_QUEUE_MAX_RECORDS=8
CONFIG_SYNAP_QUEUE_MAX_RECORD_BYTES=32768
CONFIG_SYNAP_DEAD_LETTER_MAX_RECORDS=4
```
